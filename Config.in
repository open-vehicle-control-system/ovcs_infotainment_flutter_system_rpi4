## Config.in
```kconfig
# Add project-specific packages for Buildroot here
#
# If these are non-proprietary, please consider contributing them back to
# Nerves or Buildroot.
source "$NERVES_DEFCONFIG_DIR/packages/google-libflutter/Config.in"
source "$NERVES_DEFCONFIG_DIR/packages/smrt-flutter-pi/Config.in"
```

## packages/google-libflutter/Config.in
```kconfig
config BR2_PACKAGE_GOOGLE_LIBFLUTTER
	bool

comment "google-libflutter needs an ARM/ARM64 architecture and a toolchain w/ dynamic library, threads"
	depends on BR2_USE_MMU # fork()
	depends on BR2_PACKAGE_GOOGLE_LIBFLUTTER
	depends on !BR2_PACKAGE_HAS_LIBEGL
	depends on BR2_STATIC_LIBS || !BR2_TOOLCHAIN_HAS_THREADS

config BR2_PACKAGE_GOOGLE_LIBFLUTTER
	bool "google-libflutter"
	depends on BR2_USE_MMU # fork()
	depends on !BR2_STATIC_LIBS
	depends on BR2_TOOLCHAIN_HAS_THREADS
	depends on BR2_PACKAGE_HAS_LIBEGL
	select BR2_PACKAGE_FREETYPE
	select BR2_PACKAGE_LIBINPUT
	select BR2_PACKAGE_LIBXKBCOMMON
	select BR2_PACKAGE_XKEYBOARD_CONFIG
	help
	  Google's flutter engine (libflutter.so) which is required to run Flutter asset bundles, this breaks a lot of buildroot conventions.

	  https://github.com/flutter/engine

if BR2_PACKAGE_GOOGLE_LIBFLUTTER

config BR2_PACKAGE_GOOGLE_LIBFLUTTER_ENABLE_DEBUG
	bool "google-libflutter-debug"
	default n
	help
	  Also build a debug version of the library

endif
```

## packages/smrt-flutter-pi/Config.in
```kconfig
config BR2_PACKAGE_SMRT_FLUTTER_PI_ARCH_SUPPORTS
	bool
	default y if BR2_arm || BR2_aarch64

comment "smrt-flutter-pi needs an ARM architecture and a toolchain w/ dynamic library, threads"
	depends on BR2_USE_MMU # fork()
	depends on BR2_PACKAGE_FLUTTER_PI_ARCH_SUPPORTS
	depends on !BR2_PACKAGE_HAS_LIBEGL
	depends on BR2_STATIC_LIBS || !BR2_TOOLCHAIN_HAS_THREADS

config BR2_PACKAGE_SMRT_FLUTTER_PI
	bool "smrt-flutter-pi"
	depends on BR2_USE_MMU # fork()
	depends on !BR2_STATIC_LIBS
	depends on BR2_TOOLCHAIN_HAS_THREADS
	depends on BR2_PACKAGE_SMRT_FLUTTER_PI_ARCH_SUPPORTS
	depends on BR2_PACKAGE_GOOGLE_LIBFLUTTER
	select BR2_PACKAGE_LIBINPUT
	select BR2_PACKAGE_LIBXKBCOMMON
	select BR2_PACKAGE_XKEYBOARD_CONFIG
	select BR2_PACKAGE_LIBUEV
	help
	  A light-weight Flutter Engine Embedded for Raspberry Pi that runs without X.

	  https://github.com/ardera/flutter-pi

if BR2_PACKAGE_SMRT_FLUTTER_PI

config BR2_PACKAGE_SMRT_FLUTTER_PI_ENABLE_DEBUG
	bool "flutter-pi-debug"
	default n
	help
	  Enable debug build of Flutter Pi
endif
```
